## applications/ipc_radio/Kconfig
```kconfig
#
# Copyright (c) 2023 Nordic Semiconductor
#
# SPDX-License-Identifier: LicenseRef-Nordic-5-Clause
#

mainmenu "Nordic ipc_radio firmware"

config IPC_RADIO_802154
	bool "IPC IEEE 802.15.4 radio"
	select NRF_802154_SER_RADIO
	help
	  Enable the IPC IEEE 802.15.4 radio serialization.

config IPC_RADIO_BT
	bool "IPC Bluetooth"
	help
	  Enable the IPC Bluetooth radio serialization.

if IPC_RADIO_BT

choice IPC_RADIO_BT_SER
	default IPC_RADIO_BT_HCI_IPC
	prompt "Bluetooth serialization type"
	help
	  Type of the IPC Bluetooth radio serialization used.

config IPC_RADIO_BT_HCI_IPC
	bool "Bluetooth HCI serialization"
	depends on IPC_SERVICE
	depends on IPC_SERVICE_BACKEND_ICBMSG || IPC_SERVICE_BACKEND_RPMSG
	depends on BT_HCI_RAW
	help
	  Use Bluetooth HCI serialization over ipc_service.

config IPC_RADIO_BT_RPC
	bool "Bluetooth host API serialization over RPC"
	depends on BT_RPC_HOST
	help
	  Use nRF RPC serialization for Bluetooth.

endchoice # IPC_RADIO_BT_SER

if IPC_RADIO_BT_HCI_IPC

config QUEUE_THREAD_STACK_SIZE
	int "Queue thread stack size"
	default 512
	help
	  Stack size for the queue thread.

config QUEUE_THREAD_PRIO
	int "Queue thread priority"
	default 7
	help
	  Priority for the queue thread.

config IPC_RADIO_BT_FATAL_ERROR
	bool
	default y
	select FATAL_ERROR_HANDLERS
	help
	  The Bluetooth HCI serialization reports fatal errors over the IPC endpoint and
	  resets the core afterwards. It therefore always requires the fatal error library.

if BT_HCI_VS_FATAL_ERROR

config IPC_RADIO_BT_FATAL_ERROR_SEND_RETRIES
	int "Fatal error report send retries"
	default 100
	help
	  Number of times the Vendor Specific fatal error event is retried over the IPC
	  endpoint before the core is reset. The fatal error handler runs with interrupts
	  locked and, potentially, in an interrupt context, hence the retries are bounded
	  and use a busy wait instead of yielding.

config IPC_RADIO_BT_FATAL_ERROR_SEND_RETRY_US
	int "Fatal error report send retry delay in microseconds"
	default 100
	help
	  Busy wait time between two consecutive attempts to send the Vendor Specific fatal
	  error event over the IPC endpoint.

config IPC_RADIO_BT_FATAL_ERROR_TEST_HOOK
	bool "Fatal error test hook [EXPERIMENTAL]"
	depends on BT_HCI_RAW_CMD_EXT
	select EXPERIMENTAL
	select IRQ_OFFLOAD
	help
	  Register a Vendor Specific HCI command that injects a fatal error in the selected
	  execution context. This is only used by the tests validating that the fatal error
	  report reaches the host, and must not be enabled in production images.

	  Note that the IPC service backends are not guaranteed to be callable from a
	  zero-latency interrupt context. When the report cannot be sent, the core is reset
	  without reporting the fatal error.

if IPC_RADIO_BT_FATAL_ERROR_TEST_HOOK

config IPC_RADIO_BT_FATAL_ERROR_TEST_HOOK_ZLI
	bool "Fatal error test hook zero latency interrupt context"
	default y
	depends on ZERO_LATENCY_IRQS
	depends on SOC_COMPATIBLE_NRF53X || SOC_SERIES_NRF54H
	help
	  Allow injecting the fatal error from a zero-latency interrupt context.

config IPC_RADIO_BT_FATAL_ERROR_TEST_HOOK_ZLI_IRQN
	int "Zero latency interrupt line used by the fatal error test hook"
	depends on IPC_RADIO_BT_FATAL_ERROR_TEST_HOOK_ZLI
	default 27 if SOC_COMPATIBLE_NRF53X # SWI1
	default 89 if SOC_SERIES_NRF54H # SWI1
	help
	  Software interrupt line used to raise the fatal error from a zero-latency interrupt
	  context. It must not be used by any other component, in particular not by the
	  MPSL_LOW_PRIO_IRQN interrupt line.

endif # IPC_RADIO_BT_FATAL_ERROR_TEST_HOOK

endif # BT_HCI_VS_FATAL_ERROR

endif # IPC_RADIO_BT_HCI_IPC

config SETTINGS
	imply ZMS if SOC_FLASH_NRF_MRAM
	imply NVS if !SOC_FLASH_NRF_MRAM

config BT_MAX_CONN
	default 4 if IPC_RADIO_802154
	default 16 if !IPC_RADIO_802154

endif # IPC_RADIO_BT

module = IPC_RADIO
module-str = "ipc_radio"
source "$(ZEPHYR_BASE)/subsys/logging/Kconfig.template.log_config"

source "Kconfig.zephyr"
```

## lib/fatal_error/Kconfig
```kconfig
#
# Copyright (c) 2019 Nordic Semiconductor ASA
#
# SPDX-License-Identifier: LicenseRef-Nordic-5-Clause
#

menuconfig RESET_ON_FATAL_ERROR
	bool "Reset on fatal error"
	select REBOOT
	select FATAL_ERROR_HANDLERS
	help
	  Enable using the fatal error handler defined for Nordic DKs.
	  When it is used, the system restarts after a fatal error.

config FATAL_ERROR_HANDLERS
	bool
	help
	  Compile the fatal error library and install its k_sys_fatal_error_handler
	  implementation, which runs all handlers registered with
	  FATAL_ERROR_HANDLER_DEFINE before the system is reset or halted.

	  This is a hidden symbol that is selected by RESET_ON_FATAL_ERROR and by
	  the modules registering a fatal error handler.

if FATAL_ERROR_HANDLERS

module = FATAL_ERROR
module-str = Fatal error
source "$(ZEPHYR_BASE)/subsys/logging/Kconfig.template.log_config"

endif # FATAL_ERROR_HANDLERS
```

## tests/bluetooth/hci_vs_fatal_error/testcase.yaml
```yaml
common:
  sysbuild: true
  harness: ztest
  tags:
    - bluetooth
    - ci_build
    - sysbuild
    - ci_tests_bluetooth_hci_vs_fatal_error
tests:
  bluetooth.hci_vs_fatal_error:
    platform_allow:
      - nrf5340dk/nrf5340/cpuapp
      - nrf54h20dk/nrf54h20/cpuapp
    integration_platforms:
      - nrf5340dk/nrf5340/cpuapp
      - nrf54h20dk/nrf54h20/cpuapp
```
