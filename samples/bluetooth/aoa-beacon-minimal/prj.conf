## CMakeLists.txt
```
# Copyright 2021 u-blox
# 
# Licensed under the Apache License, Version 2.0 (the "License");
# you may not use this file except in compliance with the License.
# You may obtain a copy of the License at
# 
#  http://www.apache.org/licenses/LICENSE-2.0
# 
# Unless required by applicable law or agreed to in writing, software
# distributed under the License is distributed on an "AS IS" BASIS,
# WITHOUT WARRANTIES OR CONDITIONS OF ANY KIND, either express or implied.
# See the License for the specific language governing permissions and
# limitations under the License.

cmake_minimum_required(VERSION 3.13.1)

find_package(Zephyr HINTS $ENV{ZEPHYR_BASE})
project(direction_finding_beacon)

FILE(GLOB app_sources src/*.c)
target_sources(app PRIVATE ${app_sources})
```

## prj.conf
```kconfig
# Copyright 2021 u-blox
# 
# Licensed under the Apache License, Version 2.0 (the "License");
# you may not use this file except in compliance with the License.
# You may obtain a copy of the License at
# 
#  http://www.apache.org/licenses/LICENSE-2.0
# 
# Unless required by applicable law or agreed to in writing, software
# distributed under the License is distributed on an "AS IS" BASIS,
# WITHOUT WARRANTIES OR CONDITIONS OF ANY KIND, either express or implied.
# See the License for the specific language governing permissions and
# limitations under the License.

CONFIG_BT_DEVICE_NAME="u-blox AoA 1M"
CONFIG_ASSERT=y
CONFIG_BT_ID_MAX=1
CONFIG_BT_CTLR_TX_PWR_PLUS_4=y
CONFIG_BT_CTLR_TX_PWR_DYNAMIC_CONTROL=y

CONFIG_BT=y
CONFIG_BT_MAX_CONN=2
CONFIG_BT_BUF_ACL_RX_SIZE=251
CONFIG_BT_L2CAP_TX_MTU=247

# Extended and periodic advertising
CONFIG_BT_CTLR=y
CONFIG_BT_LL_SW_SPLIT=n # Normally use LL_SPLIT, but not now. Config not cleaned up for using Softdevice controller, but ignore warnings.

CONFIG_BT_EXT_ADV=y
CONFIG_BT_PER_ADV=y
CONFIG_BT_BROADCASTER=y
CONFIG_BT_PERIPHERAL=y
CONFIG_BT_CTLR_ADV_EXT=y
CONFIG_BT_CTLR_ADV_PERIODIC=y
CONFIG_BT_EXT_ADV_MAX_ADV_SET=2
CONFIG_BT_CTLR_ADV_AUX_SET=2
CONFIG_BT_CTLR_ADV_DATA_CHAIN=y
CONFIG_BT_CTLR_ADV_DATA_LEN_MAX=256

# Enable Direction Finding TX Feature including AoA and AoD
CONFIG_BT_DF=y
CONFIG_BT_CTLR_DF=y
CONFIG_BT_CTLR_DF_ANT_SWITCH_TX=n
CONFIG_BT_CTLR_DF_ANT_SWITCH_RX=n
CONFIG_BT_CTLR_ADVANCED_FEATURES=y
CONFIG_BT_CTLR_ADV_SYNC_PDU_BACK2BACK=y
CONFIG_BT_CTLR_DF_PER_ADV_CTE_NUM_MAX=1

# No external XTAL on C209
CONFIG_CLOCK_CONTROL_NRF_K32SRC_RC=y

CONFIG_MAIN_STACK_SIZE=4096
CONFIG_SYSTEM_WORKQUEUE_STACK_SIZE=4096
CONFIG_BT_RX_STACK_SIZE=2048

CONFIG_NVS=y
CONFIG_FLASH=y
CONFIG_FLASH_PAGE_LAYOUT=y
CONFIG_FLASH_MAP=y
CONFIG_MPU_ALLOW_FLASH_WRITE=y

CONFIG_UART_NRFX=y
CONFIG_UART_ASYNC_API=y
CONFIG_UART_USE_RUNTIME_CONFIGURE=y
CONFIG_SERIAL=y

CONFIG_PM_DEVICE_RUNTIME=y
CONFIG_REBOOT=y

CONFIG_BT_PRIVACY=n

# SEGGER RTT logging instead of UART
CONFIG_LOG_PRINTK=y
CONFIG_LOG=y
CONFIG_DEBUG_OPTIMIZATIONS=y
CONFIG_UART_CONSOLE=y
CONFIG_LOG_BACKEND_UART=y
# End of SEGGER RTT

# This should not be needed but it is for debug builds otherwise in NCS 2.0.0
# we get stack overflows in BT controller.
CONFIG_BT_HCI_TX_STACK_SIZE_WITH_PROMPT=y
CONFIG_BT_HCI_TX_STACK_SIZE=1024
```

## src/main.c
```c
/*
 * Copyright 2021 u-blox
 *
 * Licensed under the Apache License, Version 2.0 (the "License");
 * you may not use this file except in compliance with the License.
 * You may obtain a copy of the License at
 *
 *  http://www.apache.org/licenses/LICENSE-2.0
 *
 * Unless required by applicable law or agreed to in writing, software
 * distributed under the License is distributed on an "AS IS" BASIS,
 * WITHOUT WARRANTIES OR CONDITIONS OF ANY KIND, either express or implied.
 * See the License for the specific language governing permissions and
 * limitations under the License.
 */

#include <zephyr/kernel.h>
#include <zephyr/bluetooth/controller.h>

#include <string.h>
#include <zephyr/bluetooth/bluetooth.h>
#include <zephyr/bluetooth/hci.h>
#include "bt_adv.h"
#include <zephyr/random/random.h>
#include <zephyr/sys/__assert.h>
#include "bt_util.h"
#include <zephyr/bluetooth/hci.h>
#include <zephyr/bluetooth/hci_vs.h>
#include <zephyr/sys/byteorder.h>
#include <zephyr/logging/log.h>

LOG_MODULE_REGISTER(app, LOG_LEVEL_DBG);

static uint16_t advIntervals[] = {50, 100, 250, 1000};
static uint8_t advIntervalIndex = 0;

static uint8_t uuid[EDDYSTONE_INSTANCE_ID_LEN];

int main(void)
{
    uint8_t randDelayMs;
    bt_addr_le_t addr;

    // If all tags are powered on at once their advertisements may collide.
    // Use a random delay in order to give them some random offset.
    randDelayMs = (uint8_t)(sys_rand32_get() & 0xFF);
    k_msleep(randDelayMs);
    LOG_DBG("Slept %dms", randDelayMs);
    utilGetBtAddr(&addr);

    for (uint8_t i = 0; i < EDDYSTONE_INSTANCE_ID_LEN; i++) {
        uuid[i] = addr.a.val[(EDDYSTONE_INSTANCE_ID_LEN - 1) - i];
    }

    // EDDYSTONE UID is the MAC for easy identification in this bug hunting session.
    LOG_HEXDUMP_INF(uuid, EDDYSTONE_INSTANCE_ID_LEN, "InstanceId (MAC)");

    bt_ctlr_set_public_addr(addr.a.val);
    __ASSERT(bt_enable(NULL) == 0, "Bluetooth init failed");
    btAdvInit(advIntervals[advIntervalIndex], advIntervals[advIntervalIndex], NULL, uuid, 0);

    struct bt_data adData;
    adData.type = BT_DATA_MANUFACTURER_DATA;
    adData.data = (uint8_t *)uuid;
    adData.data_len = EDDYSTONE_INSTANCE_ID_LEN;
    btAdvSetPerAdvData(&adData, 1);
    btAdvStart();

    return 0;
}
```

## src/bt_adv.c
```c
/*
 * Copyright 2021 u-blox
 *
 * Licensed under the Apache License, Version 2.0 (the "License");
 * you may not use this file except in compliance with the License.
 * You may obtain a copy of the License at
 *
 *  http://www.apache.org/licenses/LICENSE-2.0
 *
 * Unless required by applicable law or agreed to in writing, software
 * distributed under the License is distributed on an "AS IS" BASIS,
 * WITHOUT WARRANTIES OR CONDITIONS OF ANY KIND, either express or implied.
 * See the License for the specific language governing permissions and
 * limitations under the License.
 */

#include "bt_adv.h"
#include <zephyr/bluetooth/bluetooth.h>
#include <zephyr/bluetooth/hci.h>
#include <zephyr/sys/__assert.h>
#include <zephyr/logging/log.h>

#include <zephyr/bluetooth/bluetooth.h>
#include <zephyr/bluetooth/hci.h>
#include <zephyr/bluetooth/direction.h>
#include <zephyr/sys/byteorder.h>
#include <zephyr/sys/util.h>

LOG_MODULE_REGISTER(bt_adv_aoa, LOG_LEVEL_DBG);

/* Length of CTE in unit of 8[us] */
#define CTE_LEN (0x14U)

/* Number of CTE send in single periodic advertising train
* Tradeoff with power consumption for the tag and
* number of samples received at anchor.
*/
#define PER_ADV_EVENT_CTE_COUNT 1

// Offsets of the different data in bt_data ad[] below
#define ADV_DATA_OFFSET_NAMESPACE   4
#define ADV_DATA_OFFSET_INSTANCE    14
#define ADV_DATA_OFFSET_RFU         20
#define ADV_DATA_OFFSET_TX_POWER    3

#define CONFIG_EXT_ADV_INT_MS_MIN 200
#define CONFIG_EXT_ADV_INT_MS_MAX 300

static struct bt_le_adv_param param =
// Below intervals are a tradeoff between power consumption and the time
// it takes for the scanner to start tracking this tag. Set it accordingly.
    BT_LE_ADV_PARAM_INIT(BT_LE_ADV_OPT_EXT_ADV |
                         BT_LE_ADV_OPT_USE_NAME | BT_LE_ADV_OPT_NO_2M | BT_LE_ADV_OPT_USE_IDENTITY,
                         CONFIG_EXT_ADV_INT_MS_MIN / 0.625,
                         CONFIG_EXT_ADV_INT_MS_MAX / 0.625,
                         NULL);


static struct bt_le_ext_adv_start_param ext_adv_start_param = {
    .timeout = 0,
    .num_events = 0,
};

struct bt_df_adv_cte_tx_param cte_params = { .cte_len = CTE_LEN,
           .cte_count = PER_ADV_EVENT_CTE_COUNT,
           .cte_type = BT_DF_CTE_TYPE_AOA,
           .num_ant_ids = 0,
           .ant_ids = NULL
};

static struct bt_data ad[] = {
    BT_DATA_BYTES(BT_DATA_FLAGS, BT_LE_AD_NO_BREDR),
    BT_DATA_BYTES(BT_DATA_UUID16_ALL, 0xaa, 0xfe),
    BT_DATA_BYTES(BT_DATA_SVC_DATA16,
                  0xaa, 0xfe, /* Eddystone UUID */
                  0x00, /* Eddystone-UID frame type */
                  0x00, /* TX Power */
                  'N', 'I', 'N', 'A', '-', 'B', '4', 'T', 'A', 'G', /* Namespace placeholder, will be replaced in init */
                  'i', 'n', 's', 't', 'a', 'e', /* Instance Id placeholder, will be replaced in init */
                  0x00, /* reserved */
                  0x00 /* reserved */
                 )
};

static struct bt_le_ext_adv *adv_set;
static uint16_t minAdvInterval;
static uint16_t maxAdvInterval;
static bool advRunning;

void btAdvInit(uint16_t min_int, uint16_t max_int, uint8_t *namespace, uint8_t *instance_id,
               int8_t txPower)
{
    minAdvInterval = min_int / 1.25;
    maxAdvInterval = max_int / 1.25;
    advRunning = false;

    memcpy((uint8_t *)&ad[2].data[ADV_DATA_OFFSET_NAMESPACE], namespace, EDDYSTONE_NAMESPACE_LENGFTH);
    memcpy((uint8_t *)&ad[2].data[ADV_DATA_OFFSET_INSTANCE], instance_id, EDDYSTONE_INSTANCE_ID_LEN);
    memcpy((uint8_t *)&ad[2].data[ADV_DATA_OFFSET_TX_POWER], &txPower, sizeof(txPower));

    LOG_INF("Create ext. adv...");
    int err = bt_le_ext_adv_create(&param, NULL, &adv_set);
    if (err) {
        LOG_ERR("failed (err %d)\n", err);
        return;
    }
    LOG_INF("success\n");

    LOG_INF("Set ext adv data...");
    err = bt_le_ext_adv_set_data(adv_set, ad, ARRAY_SIZE(ad), NULL, 0);
    if (err) {
        LOG_ERR("Failed setting ext adv data: %d\n", err);
    }
    LOG_INF("success\n");

    LOG_INF("Update CTE params...");
    err = bt_df_set_adv_cte_tx_param(adv_set, &cte_params);
    if (err) {
        LOG_ERR("failed (err %d)\n", err);
        return;
    }
    LOG_INF("success\n");

    LOG_INF("Periodic advertising params set...");
    struct bt_le_per_adv_param per_adv_param = {
        .interval_min = minAdvInterval,
        .interval_max = maxAdvInterval,
        .options = BT_LE_ADV_OPT_USE_TX_POWER,
    };
    err = bt_le_per_adv_set_param(adv_set, &per_adv_param);
    if (err) {
        LOG_ERR("failed (err %d)\n", err);
        return;
    }
    LOG_INF("success\n");

    LOG_INF("Enable CTE...");
    err = bt_df_adv_cte_tx_enable(adv_set);
    if (err) {
        LOG_ERR("failed (err %d)\n", err);
        return;
    }
    LOG_INF("success\n");
}

void btAdvStart(void)
{
    if (advRunning) {
        LOG_WRN("Periodic adv. already running");
        return;
    }
    LOG_INF("Periodic advertising enable...");
    int err = bt_le_per_adv_start(adv_set);
    if (err) {
        LOG_ERR("failed (err %d)\n", err);
        return;
    }
    LOG_INF("success\n");

    LOG_INF("Extended advertising enable...");
    err = bt_le_ext_adv_start(adv_set, &ext_adv_start_param);
    if (err) {
        LOG_ERR("failed (err %d)\n", err);
        return;
    }
    advRunning = true;
    LOG_INF("success\n");
}

void btAdvStop(void)
{
    if (!advRunning) {
        LOG_WRN("Periodic adv. already stopped");
        return;
    }
    __ASSERT_NO_MSG(0 == bt_le_per_adv_stop(adv_set));
    __ASSERT_NO_MSG(0 == bt_le_ext_adv_stop(adv_set));
    LOG_INF("Adv stopped");
    advRunning = false;
}

bool btAdvUpdateAdvInterval(uint16_t min, uint16_t max)
{
    minAdvInterval = min / 1.25;
    maxAdvInterval = max / 1.25;
    btAdvStop();
    struct bt_le_per_adv_param per_adv_param = {
        .interval_min = minAdvInterval,
        .interval_max = maxAdvInterval,
        .options = BT_LE_ADV_OPT_USE_TX_POWER,
    };
    int err = bt_le_per_adv_set_param(adv_set, &per_adv_param);
    if (err) {
        LOG_ERR("failed (err %d)\n", err);
    }
    LOG_INF("success\n");
    btAdvStart();

    return err == 0;
}

void btAdvSetPerAdvData(struct bt_data *data, int len)
{
    LOG_INF("Set per adv data...");
    int err = bt_le_per_adv_set_data(adv_set, data, len);
    if (err) {
        LOG_ERR("failed (err %d)\n", err);
        return;
    }
}

void btAdvSetReservedEddystoneData(uint8_t rfu1, uint8_t rfu2)
{
    *((uint8_t *)&ad[2].data[ADV_DATA_OFFSET_RFU]) = rfu1;
    *((uint8_t *)&ad[2].data[ADV_DATA_OFFSET_RFU + 1]) = rfu2;

    LOG_INF("Set ext adv data with RFU bytes changed...");
    int err = bt_le_ext_adv_set_data(adv_set, ad, ARRAY_SIZE(ad), NULL, 0);
    if (err) {
        LOG_ERR("Failed setting ext adv data: %d\n", err);
        return;
    }
    LOG_INF("success\n");
}
```

## src/bt_adv.h
```c
/*
 * Copyright 2021 u-blox
 *
 * Licensed under the Apache License, Version 2.0 (the "License");
 * you may not use this file except in compliance with the License.
 * You may obtain a copy of the License at
 *
 *  http://www.apache.org/licenses/LICENSE-2.0
 *
 * Unless required by applicable law or agreed to in writing, software
 * distributed under the License is distributed on an "AS IS" BASIS,
 * WITHOUT WARRANTIES OR CONDITIONS OF ANY KIND, either express or implied.
 * See the License for the specific language governing permissions and
 * limitations under the License.
 */

#ifndef __BT_ADV_H
#define __BT_ADV_H

#include <zephyr/kernel.h>
#include <zephyr/bluetooth/bluetooth.h>

#define EDDYSTONE_INSTANCE_ID_LEN   6
#define EDDYSTONE_NAMESPACE_LENGFTH 10

/**
 * @brief   Init BT advertising
 * @details Initializes advertising, but does not start it.
 *
 * @param   min_int         Min adv. interval in milliseconds
 * @param   max_int         Max adv. interval in milliseconds
 * @param   namespace       Pointer to the namespace to be sent in Eddystone beacon.
 * @param   instance_id     Pointer to the instance ID to be sent in Eddystone beacon.
 * @param   txPower         The TX power put in advertising data
 */
void btAdvInit(uint16_t min_int, uint16_t max_int, uint8_t *namespace, uint8_t *instance_id,
               int8_t txPower);

/**
 * @brief   Start BT advertising
 * @details Start advertising, will not stop until stop function called.
 */
void btAdvStart(void);

/**
 * @brief   Stop BT advertising
 * @details Stop advertising, call btAdvStart to enable advertising again.
 */
void btAdvStop(void);

/**
 * @brief   Change the advertsing interval
 * @details Change the advertising interval, advertsing will be stopped and restarted with the new interval.
 *
 * @param   min_int         Min adv. interval in milliseconds
 * @param   max_int         Max adv. interval in milliseconds
 *
 * @return                  True if success, false otherwise.
 */
bool btAdvUpdateAdvInterval(uint16_t min, uint16_t max);

/**
 * @brief Set or update the periodic advertising data.
 *
 * Advertising must be initialized before calling.
 *
 * @param ad        Advertising data.
 * @param ad_len    Advertising data length.
 *
 */
void btAdvSetPerAdvData(struct bt_data *data, int len);

/**
 * @brief Set the reserved Eddystone data.
 *
 * Allows setting the RFU1 and RFU2 bytes in the Eddystone data for payload
 * transmission to locator.
 * @param rfu1      RFU1 byte.
 * @param rfu2      RFU2 byte.
 *
 */
void btAdvSetReservedEddystoneData(uint8_t rfu1, uint8_t rfu2);

#endif
```
